## conf/layer.conf
```bitbake
# We have a conf and classes directory, append to BBPATH
BBPATH .= ":${LAYERDIR}"

# We have a recipes directory, add to BBFILES
BBFILES += "${LAYERDIR}/recipes*/*/*.bb ${LAYERDIR}/recipes*/*/*.bbappend"

BBFILE_COLLECTIONS += "lts-go-mixin"
BBFILE_PATTERN_lts-go-mixin := "^${LAYERDIR}/"
BBFILE_PRIORITY_lts-go-mixin = "6"

LAYERSERIES_COMPAT_lts-go-mixin = "kirkstone"

LAYERDEPENDS_lts-go-mixin = " \
    core \
"

GOVERSION = "1.22%"

# Since go-1.21 GOPROXY needs to be set explicitly, otherwise it fails with:
# GOPROXY list is not the empty string, but contains no entries
export GOPROXY ??= "https://proxy.golang.org,direct"

# fixup 6ad90f backport and remove the linkmode
# https://git.openembedded.org/openembedded-core/commit/?id=6ad90fc2fc49c4199a59dfb1c1d81a7ba184a522
GO_LINKMODE:remove = "--linkmode=external"

# Fix preferred version not available warning:
# WARNING: preferred version 1.22% of go-native not available (for item go-native)
# WARNING: versions of go-native available: 1.17.13
# go-native was removed in oe-core master
# https://git.openembedded.org/openembedded-core/commit/?id=876d344d2ec3d6ce283d01974146392d76685824
PREFERRED_VERSION_go-native = ""
```
